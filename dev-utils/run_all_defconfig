## package/ewget/Config.in
```kconfig
if PACKAGE_ewget

comment "SSL support"

choice
	prompt "Selected SSL library"
	default EWGET_MBEDTLS

	config EWGET_MBEDTLS
		bool "mbed TLS"

	config EWGET_OPENSSL
		bool "OpenSSL"

endchoice

endif
```

## package/libimobiledevice/Config.in
```kconfig
if PACKAGE_libimobiledevice

comment "SSL support"

choice
	prompt "Selected SSL library"
	default LIBIMOBILEDEVICE_MBEDTLS

	config LIBIMOBILEDEVICE_MBEDTLS
		bool "mbed TLS"

	config LIBIMOBILEDEVICE_OPENSSL
		bool "OpenSSL"

endchoice

endif
```

## package/openvpn-easy-rsa/Config.in
```kconfig
if PACKAGE_openvpn-gargoyle-easy-rsa

comment "SSL support"

choice
	prompt "Selected SSL library"
	default OPENVPN_GARGOYLE_EASYRSA_MBEDTLS if !GARGOYLE_SSL_OPENSSL
	default OPENVPN_GARGOYLE_EASYRSA_OPENSSL if GARGOYLE_SSL_OPENSSL

	config OPENVPN_GARGOYLE_EASYRSA_MBEDTLS
		bool "mbed TLS"

	config OPENVPN_GARGOYLE_EASYRSA_OPENSSL
		bool "OpenSSL"

endchoice

endif
```

## package/openvpn/Config.in
```kconfig
menu "Configuration"
	depends on PACKAGE_openvpn

config OPENVPN_DISABLE_LZO
	bool "Disable LZO compression support"
	depends on PACKAGE_openvpn
	default n

config OPENVPN_DISABLE_CRYPTO
	bool "Disable OpenSSL crypto support"
	depends on PACKAGE_openvpn
	default n

config OPENVPN_DISABLE_SSL
	bool "Disable OpenSSL SSL support for TLS-based key exchange"
	depends on PACKAGE_openvpn
	default n

config OPENVPN_X509_ALT_USERNAME
	bool "Enable the --x509-username-field feature"
	depends on PACKAGE_openvpn
	default n

config OPENVPN_DISABLE_MULTI
	bool "Disable client/server support (--mode server + client mode)"
	depends on PACKAGE_openvpn
	default n

config OPENVPN_DISABLE_SERVER
	bool "Disable server support only (but retain client support)"
	depends on PACKAGE_openvpn
	default n

config OPENVPN_DISABLE_EUREPHIA
	bool "Disable support for the eurephia plug-in"
	depends on PACKAGE_openvpn
	default y

config OPENVPN_DISABLE_MANAGEMENT
	bool "Disable management server support"
	depends on PACKAGE_openvpn
	default y

config OPENVPN_DISABLE_PKCS11
	bool "Disable pkcs11 support"
	depends on PACKAGE_openvpn
	default n

config OPENVPN_DISABLE_HTTP
	bool "Disable HTTP proxy support"
	depends on PACKAGE_openvpn
	default n

config OPENVPN_DISABLE_FRAGMENT
	bool "Disable internal fragmentation support (--fragment)"
	depends on PACKAGE_openvpn
	default n

config OPENVPN_DISABLE_MULTIHOME
	bool "Disable multi-homed UDP server support (--multihome)"
	depends on PACKAGE_openvpn
	default n

config OPENVPN_DISABLE_PORT_SHARE
	bool "Disable TCP server port-share support (--port-share)"
	depends on PACKAGE_openvpn
	default n

config OPENVPN_DISABLE_DEF_AUTH
	bool "Disable deferred authentication"
	depends on PACKAGE_openvpn
	default n

config OPENVPN_DISABLE_PF
	bool "Disable internal packet filter"
	depends on PACKAGE_openvpn
	default n

endmenu
```

## package/plugin-gargoyle-diagnostics/Config.in
```kconfig
menu "Diagnostics Plugin Configuration"
	depends on PACKAGE_plugin-gargoyle-diagnostics

config GARGOYLE_DIAGNOSTICS
	bool "Include utilities for diagnostics"
	select BUSYBOX_CUSTOM
	select BUSYBOX_CONFIG_NSLOOKUP
	select BUSYBOX_CONFIG_PING
	select BUSYBOX_CONFIG_PING6
	select BUSYBOX_CONFIG_TRACEROUTE
	select BUSYBOX_CONFIG_TRACEROUTE6
	help
		This includes utilities such as ping, traceroute and nslookup.
	default y

endmenu
```

## package/plugin-gargoyle-usb-storage-full/Config.in
```kconfig
if PACKAGE_plugin-gargoyle-usb-storage-full

comment "SMB Server"

choice
	prompt "Select Default SMB Server"
	default GARGOYLE_SMB_KSMBD

	config GARGOYLE_SMB_KSMBD
		bool "KSMBD"

	config GARGOYLE_SMB_SAMBA
		bool "Samba"

endchoice

endif
```

## package/samba3/Config.in
```kconfig
config SAMBA3_DEBUG 
	bool "Enable Logging for samba3"
	depends PACKAGE_samba3
	default n
```

## package/usbmuxd/Config.in
```kconfig
if PACKAGE_usbmuxd

comment "SSL support"

choice
	prompt "Selected SSL library"
	default USBMUXD_MBEDTLS

	config USBMUXD_MBEDTLS
		bool "mbed TLS"

	config USBMUXD_OPENSSL
		bool "OpenSSL"

endchoice

endif
```
